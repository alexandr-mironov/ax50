## ugw/target/linux/lantiq/linux-3.10.104-sources/drivers/net/ethernet/intel/vrx518/Kconfig
```kconfig
#
# Intel VRX518 device configuration
#

config VRX518_TC
    tristate "Intel(R) VRX518 DSL TC support"
    depends on VRX518
    ---help---
      This driver supports Intel(R) VRX518 DSL TC functions.
      it support ATM mode, PTM mode and PTM bonding mode.

      Bonding packet's scatter-gathering requires SoC HW support.

config TEST
	tristate "Intel(R) VRX518 SmartPHY DSL Test Driver"
	depends on VRX518
	---help---
	  This driver supports Intel(R) VRX518 DSL interrupt and ACA test. 

	  To compile this driver as a module, choose M here. The module
	  will be called vrx518.  MSI interrupt support is required for
	  this driver to work correctly.
```

## ugw/target/linux/lantiq/linux-3.10.104-sources/net/lantiq/Kconfig
```kconfig
#
# mcast_helper configuration
#


config LANTIQ_MCAST_HELPER
	tristate "Multicast Helper support"
	default n
	help
		mcast_helper support

config LANTIQ_MCAST_HELPER_ACL
	tristate "Multicast Helper ACL support"
	depends on LANTIQ_MCAST_HELPER
        default y
        help
                mcast_helper ACL support
	
config LANTIQ_MCAST_HELPER_M2U
	tristate "Multicast Helper multicast to unicast support"
	depends on LANTIQ_MCAST_HELPER
        default y
        help
                mcast_helper update multicast to unicast support
```
